## sys/Kconfig.stdio
```kconfig
# Copyright (c) 2020 HAW Hamburg
#
# This file is subject to the terms and conditions of the GNU Lesser
# General Public License v2.1. See the file LICENSE in the top level
# directory for more details.
#

menu "Standard Input/Ouput (STDIO)"

choice
    bool "STDIO implementation"
    default MOD_STDIO_UART

config MOD_STDIO_CDC_ACM
    bool "CDC ACM"
    depends on MOD_USB_CDC_ACM
    select MOD_ISRPIPE
    select HAS_STDIO_STDIN
    help
        STDIO implementation over USB CDC abstract control model.

config MOD_STDIO_ETHOS
    bool "Ethos"
    depends on MOD_ETHOS
    help
        Uses the Ethernet over Serial module (ethos).

config MOD_STDIO_NULL
    bool "Null"
    select HAS_STDIO_STDIN
    help
        Empty implementation.

config MOD_STDIO_RTT
    bool "RTT"
    depends on MOD_XTIMER
    select HAS_STDIO_STDIN

config MOD_STDIO_UART
    bool "UART"
    depends on HAS_PERIPH_UART
    select MOD_PERIPH_UART

config MOD_SLIPDEV_STDIO
    bool "SlipDev"
    select HAS_STDIO_STDIN

endchoice

config MOD_STDIO_UART_RX
    bool "STDIO UART reception"
    default y
    depends on MOD_STDIO_UART || MOD_STDIO_ETHOS
    select MOD_ISRPIPE
    select HAS_STDIO_STDIN
    help
        Reception when using UART-based (or ethos) STDIO needs to be enabled.

config MOD_STDIN
    bool "Standard Input"
    default y
    depends on HAS_STDIO_STDIN

config HAS_STDIO_STDIN
    bool
    help
        Indicates that the STDIO implementation provides STDIN.

endmenu # Standard Input/Ouput (STDIO)
```
